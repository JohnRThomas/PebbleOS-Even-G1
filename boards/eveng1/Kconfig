## boards/eveng1/Kconfig
```kconfig
# SPDX-FileCopyrightText: 2026 Core Devices LLC
# SPDX-License-Identifier: Apache-2.0

config BOARD_EVENG1
    bool
    default y
```

## src/fw/drivers/flash/Kconfig
```kconfig
# SPDX-FileCopyrightText: 2026 Core Devices LLC
# SPDX-License-Identifier: Apache-2.0

menuconfig FLASH
    bool "Flash"
    help
      Flash Drivers

if FLASH

config FLASH_GD25LQ255E
    bool "GigaDevice GD25LQ255E"
    help
      Support for the GigaDevice GD25LQ255E NOR flash.

config FLASH_GD25Q256E
    bool "GigaDevice GD25Q256E"
    help
      Support for the GigaDevice GD25Q256E NOR flash.

config FLASH_QEMU
    bool "QEMU External Flash"
    help
      Support for the QEMU external flash peripheral.

config NORDIC_QSPI_NOR
    bool "NRF5 QSPI NOR Flash"
    help
      NRF5 QSPI NOR flash supporting the JEDEC CFI interface (such as MX25R6435F)

module = DRIVER_FLASH
module-str = Flash
source "src/fw/Kconfig.template.log_level"

endif # FLASH
```

## src/fw/drivers/pmic/Kconfig
```kconfig
# SPDX-FileCopyrightText: 2026 Core Devices LLC
# SPDX-License-Identifier: Apache-2.0

menuconfig PMIC
    bool "PMIC"
    help
      PMIC Drivers

if PMIC

config PMIC_NPM1300
    bool "Nordic nPM1300"
    help
      Support for the Nordic nPM1300 PMIC.

config PMIC_NPM1300_IRQ
    bool "nPM1300 host interrupt"
    depends on PMIC_NPM1300
    default y
    help
      Route nPM1300 charger/VBUS events to the host through nPM1300
      GPIO1. Without it, charger state changes are picked up by polling.

module = DRIVER_PMIC
module-str = PMIC
source "src/fw/Kconfig.template.log_level"

endif # PMIC
```

## third_party/hal_nordic/Kconfig
```kconfig
# SPDX-FileCopyrightText: 2026 Core Devices LLC
# SPDX-License-Identifier: Apache-2.0

menuconfig HAL_NORDIC
    bool "Nordic nrfx HAL"
    help
      Build the Nordic nrfx HAL.

if HAL_NORDIC

config HAL_NORDIC_NRF52840
    bool "nRF52840 SoC variant"
    help
      Configure the nrfx HAL for the Nordic nRF52840 SoC. This sets
      the NRF52840_XXAA target define and enables the nrfx drivers
      used by Pebble (I2S, GPIOTE, PDM, PPI, PWM, SPIM3, TIMER1/2,
      TWIM0/1, UARTE0). It also disables NFCT pin usage so those pins
      can be used as GPIOs and enables GPIO-as-pin-reset.

config HAL_NORDIC_NRF5340
    bool "nRF5340 SoC variant"
    help
      Configure the nrfx HAL for the Nordic nRF5340 SoC application
      core. This sets the NRF5340_XXAA_APPLICATION target define and
      enables the nrfx drivers used by Pebble (DPPI, GPIOTE0, PDM0,
      PWM0, SPIM4, TIMER1/2, TWIM1/2, UARTE0).

endif # HAL_NORDIC
```
